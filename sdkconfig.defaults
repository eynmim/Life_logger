## sdkconfig.defaults
```kconfig
# ── CPU ──
CONFIG_ESP32S3_DEFAULT_CPU_FREQ_240=y

# ── Console over USB Serial/JTAG (XIAO ESP32-S3 native USB) ──
CONFIG_ESP_CONSOLE_USB_SERIAL_JTAG=y

# ── Stack ──
CONFIG_ESP_MAIN_TASK_STACK_SIZE=8192

# ── Flash (XIAO ESP32-S3 has 8MB) ──
CONFIG_ESPTOOLPY_FLASHSIZE_8MB=y

# ── Suppress legacy I2S driver warnings ──
CONFIG_I2S_SUPPRESS_DEPRECATE_WARN=y

# ── DSP optimizations ──
CONFIG_DSP_OPTIMIZED=y
CONFIG_DSP_OPTIMIZATION=y

# ── PSRAM (XIAO ESP32-S3 = ESP32-S3R8, Octal PSRAM) ──
CONFIG_SPIRAM=y
CONFIG_SPIRAM_MODE_OCT=y
CONFIG_SPIRAM_SPEED_80M=y
CONFIG_SPIRAM_BOOT_INIT=y

# ── Cache optimization for PSRAM performance ──
CONFIG_ESP32S3_DATA_CACHE_64KB=y
CONFIG_ESP32S3_DATA_CACHE_LINE_64B=y

# ── Custom partition table (model partition for ESP-SR) ──
CONFIG_PARTITION_TABLE_CUSTOM=y
CONFIG_PARTITION_TABLE_CUSTOM_FILENAME="partitions.csv"

# ── ESP-SR model selection ──
CONFIG_SR_MN_NONE=y

# ── Task watchdog: increase for AFE processing ──
CONFIG_ESP_TASK_WDT_TIMEOUT_S=10
```
